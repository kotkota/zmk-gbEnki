## boards/shields/gbEnki_tp/Kconfig.shield
```kconfig
# Copyright (c) 2020 Pete Johanson
# SPDX-License-Identifier: MIT

config SHIELD_GBENKI_TP_LEFT
    def_bool $(shields_list_contains,gbEnki_tp_left)

config SHIELD_GBENKI_TP_RIGHT
    def_bool $(shields_list_contains,gbEnki_tp_right)
```

## config/west.yml
```yaml
manifest:
  remotes:
    - name: zmkfirmware
      url-base: https://github.com/zmkfirmware
    # - name: urob
    #   url-base: https://github.com/urob

    # zmk module for PS/2 mouse / TP driver
    - name: infused-kim
      url-base: https://github.com/infused-kim
    - name: badjeff
      url-base: https://github.com/badjeff
    - name: filippor
      url-base: https://github.com/filippor

  projects:
    - name: zmk
      remote: zmkfirmware
      revision: main
      import: app/west.yml

    # trackpoint
    - name: kb_zmk_ps2_mouse_trackpoint_driver
      remote: filippor
      revision: badjeff-4.1

    # urob ZMK modules
    # - name: zmk-adaptive-key
    #   remote: urob
    #   revision: v0.3 # set to same version as zmk above
    # - name: zmk-auto-layer
    #   remote: urob
    #   revision: v0.3 # set to same version as zmk above
    # - name: zmk-leader-key
    #   remote: urob
    #   revision: v0.3
    # - name: zmk-tri-state
    #   remote: urob
    #   revision: v0.3

  self:
    path: config
```
